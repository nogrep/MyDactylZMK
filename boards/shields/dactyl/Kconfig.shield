## boards/shields/dactyl/Kconfig.shield
```kconfig
config SHIELD_DACTYL_LEFT
    def_bool $(shield_list_contains,dactyl_left)

config SHIELD_DACTYL_RIGHT
    def_bool $(shield_list_contains,dactyl_right)
```

## config/boards/shields/dactyl/Kconfig.defconfig
```kconfig
if SHIELD_DACTYL_LEFT

    config ZMK_KEYBOARD_NAME
        default "DM(Left)"
    config ZMK_SPLIT_BLE_ROLE_CENTRAL
        default y
endif

if SHIELD_DACTYL_RIGHT
    config ZMK_KEYBOARD_NAME
        default "DM(Right)"


endif

if SHIELD_DACTYL_LEFT || SHIELD_DACTYL_RIGHT

    config SPI
	    default y

    config ZMK_SPLIT
        default y

    config ZMK_SPLIT_BLE_CENTRAL_BATTERY_LEVEL_FETCHING
        default y
        
    config ZMK_SPLIT_BLE_CENTRAL_BATTERY_LEVEL_PROXY
        default y
endif
```

## config/boards/shields/dactyl/Kconfig.shield
```kconfig
config SHIELD_DACTYL_MINI_LEFT
    def_bool $(shields_list_contains,dactyl_mini_left)
```

## config/west.yml
```yaml
manifest:
  remotes:
    - name: alinelena
      url-base: https://github.com/alinelena/
  projects:
    - name: zmk
      remote: zmkfirmware
      revision: main
      import: app/west.yml
  self:
    path: config
    
```
